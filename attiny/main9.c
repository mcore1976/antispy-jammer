/*
 * Antispy ultrasonic device for preventing voice recording 
 * with ultrasonic waves generation based on ATTINY85,
 * ATTINY85 fuses have been set to internal PLL clock 16MHz 
 * with Resistor Ladder 5-bit Digital-to-Analog converter
 * and piezzo-electric driver
 * THIS VERSION OPERATES ON 40 KHZ !!! 
 * USE 40KHZ TRANSDUCERS WITH THIS CODE
 * (C) Adam Loboda 2021, adam.loboda@wp.pl
 */

#include <stdint.h>
#include <util/delay.h>
#include <stdbool.h>
#include <avr/io.h>
#include <avr/pgmspace.h>

// PIN - PORT ASSIGNMENT DEFINITION FOR 5-BIT DAC DEVICE
#define	OUTPUTPORT		PORTB
#define	OUTPUTPORTCTRL		DDRB

 
// created in Excell / Libreoffice - will randomly 
// swing pulse width to achieve noise effect around the center frequrency 40 KHz
const uint8_t  randomized[] PROGMEM = 
  {
9,36,31,23,9,11,18,15,34,23,34,42,40,39,25,16,39,10,44,34,13,37,15,14,26,
10,17,39,37,22,8,35,23,21,40,17,20,9,23,35,38,20,26,40,22,25,7,36,15,28,
29,15,9,32,7,39,20,35,24,12,18,36,14,38,42,42,24,34,16,25,36,12,12,44,44,
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16,18,13,17,15,18,41,31,30,41,24,18,42,29,39,44,26,12,12,43,17,36,41,13,20
};


int main(void)
{
        uint16_t sequence;
        uint8_t pulsewidth, i, bulk;


        // SET OUTPUT PIN ON ALL OUTPUT PORTS
        
        OUTPUTPORTCTRL = 0b00011111;  //set all 5 LOWER bit pins as output
        OUTPUTPORT     = 0b00000000;  //set all 5 LOWER bit pins to ZERO

       //* neverending loop */
       while (1) 
       { 

          // generating WAVE on BIT0-BIT5 DAC outputs
          // values ensure random 38-42KHz frequency
      
          for(sequence=0; sequence<4096; sequence++)
           {
           // calculate pulse width 
           pulsewidth = pgm_read_byte(randomized + sequence);

             // sending a bulk of pulses with defined pulsewidth
             // you may play with number of pulses for better effect of jamming
             for(bulk=0; bulk<25; bulk++)
             {
              // send HIGH VOLTAGE - this time square wave
              // PB0 may serve as GND for PAM8403 module audio input
              OUTPUTPORT = 0b00000110; 
                                 
              // now delay to achieve desired frequency
              for(i=0; i<pulsewidth; i++)
                  {
                        asm volatile (
                                        "    nop	\n" 
                                     );
                  };
              //
              // send LOW VOLTAGE - this time square wave
              OUTPUTPORT = 0; 
              // now delay to achieve desired frequency
              for(i=0; i<(53-pulsewidth); i++)
                  {
                        asm volatile (
                                        "  nop	\n" 
                                     );
                  };
            // End of 'bulk' loop
            };
            
           // end of 'sequence' loop;
          };
          
        }; // neverending loop 

};  // end of MAIN



